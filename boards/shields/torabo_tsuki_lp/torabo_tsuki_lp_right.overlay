#include "torabo_tsuki_lp.dtsi"
#include <input/processors.dtsi>
#include <dt-bindings/zmk/input_transform.h>

&zip_temp_layer {
    excluded-positions = <15 16 17 18 19>;
    require-prior-idle-ms = <500>;
};

&trackball_listener {
    input-processors =
        <&zip_xy_scaler 1 2>,
        <&zip_xy_transform (INPUT_TRANSFORM_X_INVERT | INPUT_TRANSFORM_Y_INVERT)>,
        <&zip_temp_layer 1 10000>;

    scroll-layer-3 {
        layers = <3>;
        input-processors = <&zip_xy_to_scroll_mapper>,
        <&zip_scroll_scaler 1 20>;
    };
};

&size_s_transform {
    col-offset = <7>;
};
